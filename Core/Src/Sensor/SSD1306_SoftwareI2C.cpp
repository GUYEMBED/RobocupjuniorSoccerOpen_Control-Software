#include "SSD1306_SoftwareI2C.h"
#include "stm32f4xx_hal.h"  // Adjust include if needed

// 5x7 font data for ASCII 32-127 (partial example, add more chars as needed)
const uint8_t SSD1306_SoftwareI2C::Font5x7[][5] = { { 0x00, 0x00, 0x00, 0x00,
		0x00 }, // 32 ' '
		{ 0x00, 0x00, 0x5F, 0x00, 0x00 }, // 33 '!'
		{ 0x00, 0x07, 0x00, 0x07, 0x00 }, // 34 '"'
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		{ 0x10, 0x08, 0x08, 0x10, 0x08 }, // 126 '~'
		};

SSD1306_SoftwareI2C::SSD1306_SoftwareI2C(GPIO_TypeDef *sclPort, uint16_t sclPin,
		GPIO_TypeDef *sdaPort, uint16_t sdaPin) :
		_sclPort(sclPort), _sclPin(sclPin), _sdaPort(sdaPort), _sdaPin(sdaPin) {
}

// Delay function for bit-banging (approx 5us)
void SSD1306_SoftwareI2C::i2cDelay() {
	for (volatile int i = 0; i < 30; i++)
		__NOP();
}

void SSD1306_SoftwareI2C::i2cStart() {
	HAL_GPIO_WritePin(_sdaPort, _sdaPin, GPIO_PIN_SET);
	HAL_GPIO_WritePin(_sclPort, _sclPin, GPIO_PIN_SET);
	i2cDelay();
	HAL_GPIO_WritePin(_sdaPort, _sdaPin, GPIO_PIN_RESET);
	i2cDelay();
	HAL_GPIO_WritePin(_sclPort, _sclPin, GPIO_PIN_RESET);
	i2cDelay();
}

void SSD1306_SoftwareI2C::i2cStop() {
	HAL_GPIO_WritePin(_sdaPort, _sdaPin, GPIO_PIN_RESET);
	HAL_GPIO_WritePin(_sclPort, _sclPin, GPIO_PIN_SET);
	i2cDelay();
	HAL_GPIO_WritePin(_sdaPort, _sdaPin, GPIO_PIN_SET);
	i2cDelay();
}

bool SSD1306_SoftwareI2C::i2cWriteByte(uint8_t byte) {
	for (int i = 0; i < 8; i++) {
		HAL_GPIO_WritePin(_sdaPort, _sdaPin,
				(byte & 0x80) ? GPIO_PIN_SET : GPIO_PIN_RESET);
		i2cDelay();
		HAL_GPIO_WritePin(_sclPort, _sclPin, GPIO_PIN_SET);
		i2cDelay();
		HAL_GPIO_WritePin(_sclPort, _sclPin, GPIO_PIN_RESET);
		i2cDelay();
		byte <<= 1;
	}

	// Read ACK (ignore for simplicity, but wait for slave to pull SDA low)
	HAL_GPIO_WritePin(_sdaPort, _sdaPin, GPIO_PIN_SET); // Release SDA for ACK
	i2cDelay();
	HAL_GPIO_WritePin(_sclPort, _sclPin, GPIO_PIN_SET);
	i2cDelay();

	// Optional: read pin to check ACK, but here we just wait a bit
	HAL_GPIO_WritePin(_sclPort, _sclPin, GPIO_PIN_RESET);
	i2cDelay();

	return true; // assume ACK
}

void SSD1306_SoftwareI2C::sendCommand(uint8_t cmd) {
	i2cStart();
	i2cWriteByte(0x78);      // OLED I2C address (0x3C << 1)
	i2cWriteByte(0x00);      // Co = 0, D/C# = 0 (command)
	i2cWriteByte(cmd);
	i2cStop();
}

void SSD1306_SoftwareI2C::sendData(uint8_t *data, uint16_t size) {
	i2cStart();
	i2cWriteByte(0x78);      // OLED I2C address (0x3C << 1)
	i2cWriteByte(0x40);      // Co = 0, D/C# = 1 (data)
	for (uint16_t i = 0; i < size; i++) {
		i2cWriteByte(data[i]);
	}
	i2cStop();
}

void SSD1306_SoftwareI2C::init() {
	// Set pins to output (open-drain assumed by hardware configuration)
	// Make sure you configured the GPIOs as output push-pull or open-drain externally

	HAL_Delay(300); // Wait for power up

	sendCommand(0xAE);             // Display off
	sendCommand(0xD5);
	sendCommand(0x80); // Set display clock div
	sendCommand(0xA8);
	sendCommand(0x3F); // Multiplex 64
	sendCommand(0xD3);
	sendCommand(0x00); // Display offset 0
	sendCommand(0x40);             // Start line 0
	sendCommand(0x8D);
	sendCommand(0x14); // Charge pump ON
	sendCommand(0x20);
	sendCommand(0x00); // Memory mode horizontal
	sendCommand(0xA1);             // Segment remap
	sendCommand(0xC8);             // COM scan dec
	sendCommand(0xDA);
	sendCommand(0x12); // COM pins
	sendCommand(0x81);
	sendCommand(0xCF); // Contrast
	sendCommand(0xD9);
	sendCommand(0xF1); // Precharge
	sendCommand(0xDB);
	sendCommand(0x40); // VCOM detect
	sendCommand(0xA4);             // Resume RAM display
	sendCommand(0xA6);             // Normal display
	sendCommand(0xAF);             // Display ON

	clearBuffer();
	displayBuffer();
}

void SSD1306_SoftwareI2C::clearBuffer() {
	for (int i = 0; i < sizeof(buffer); i++) {
		buffer[i] = 0x00;
	}
}

void SSD1306_SoftwareI2C::displayBuffer() {
	for (uint8_t page = 0; page < 8; page++) {
		sendCommand(0xB0 + page);    // Set page address
		sendCommand(0x00);           // Set lower column start address
		sendCommand(0x10);           // Set higher column start address
		sendData(&buffer[page * 128], 128);
	}
}

void SSD1306_SoftwareI2C::setPixel(uint8_t x, uint8_t y, bool on) {
	if (x >= 128 || y >= 64)
		return;
	uint16_t index = x + (y / 8) * 128;
	if (on) {
		buffer[index] |= (1 << (y % 8));
	} else {
		buffer[index] &= ~(1 << (y % 8));
	}
}

void SSD1306_SoftwareI2C::drawChar(uint8_t x, uint8_t y, char c) {
	if (c < 32 || c > 127)
		c = ' ';
	const uint8_t *charData = Font5x7[c - 32];
	for (uint8_t i = 0; i < 5; i++) {
		uint8_t line = charData[i];
		for (uint8_t j = 0; j < 8; j++) {
			setPixel(x + i, y + j, line & 0x01);
			line >>= 1;
		}
	}
}

void SSD1306_SoftwareI2C::drawText(uint8_t x, uint8_t y, const char *str) {
	while (*str) {
		drawChar(x, y, *str++);
		x += 6;
		if (x + 5 >= 128)
			break;
	}
}
